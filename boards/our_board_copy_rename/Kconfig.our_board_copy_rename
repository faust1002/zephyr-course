## boards/our_board_copy_rename/Kconfig.our_board_copy_rename
```kconfig
# Copyright (c) 2020 STMicroelectronics
# SPDX-License-Identifier: Apache-2.0

config BOARD_OUR_BOARD_COPY_RENAME
	select SOC_STM32WL55XX
```

## boards/our_board_copy_rename/board.yml
```yaml
board:
  name: our_board_copy_rename
  full_name: Our board copy rename
  vendor: Dummy vendor
  socs:
    - name: stm32wl55xx
```

## boards/our_board_from_scratch/board.yml
```yaml
board:
  name: our_board_from_scratch
  full_name: Our board from scratch
  vendor: Dummy vendor
  socs:
    - name: stm32wl55xx
```

## drivers/our-driver-module/drivers/our_driver/Kconfig
```kconfig
menuconfig OUR_DRIVER
    bool "Our Custom Driver"
    default y
    depends on DT_HAS_OUR_DRIVER_ENABLED
    help
        Dummy custom driver
```

## drivers/our-driver-module/dts/bindings/driver/our,driver.yaml
```yaml
description: Our custom sensor driver binding
compatible: "our,driver"

properties:
    callibration:
        type: int
        required: true
```
