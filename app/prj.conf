## CMakeLists.txt
```
cmake_minimum_required(VERSION 3.20.0)

cmake_path(GET CMAKE_CURRENT_LIST_DIR PARENT_PATH PARENT_DIR)
list(APPEND BOARD_ROOT ${PARENT_DIR})
list(APPEND ZEPHYR_EXTRA_MODULES ${CMAKE_CURRENT_SOURCE_DIR}/../drivers/our-driver-module)
find_package(Zephyr REQUIRED)
project(my_zephyr_app)

target_sources(app PRIVATE src/main.cpp)
```

## Kconfig
```
menuconfig LED_SUBSYSTEM
    bool "LED Subsystem"
    default y

if LED_SUBSYSTEM

choice
    prompt "LED blinking speed"
    default BLINK_SPEED_1000MS

config BLINK_SPEED_250MS
    bool "super fast (250ms)"

config BLINK_SPEED_500MS
    bool "fast (500ms)"

config BLINK_SPEED_1000MS
    bool "normal (1s)"

config BLINK_SPEED_2000MS
    bool "slow (2s)"


endchoice

config BLINK_SLEEP_TIME_MS
    int
    default 250 if BLINK_SPEED_250MS
    default 500 if BLINK_SPEED_500MS
    default 1000 if BLINK_SPEED_1000MS
    default 2000 if BLINK_SPEED_2000MS
    help
        "Time between LED toggles in milliseconds"

menuconfig LED_ADVANCED
    bool "Advanced LED Subsystem"
    default n

if LED_ADVANCED

config LED_BRIGHTNESS
    int "LED brightness (0-100)"
    range 0 100
    default 100
    help
        "LED brightness"

config LED_FADE_DURATION_MS
    int "Fade duration (ms)"
    range 0 5000
    default 500
    help
        "LED fade duration"

menu "Expert settings"
    visible if LED_ADVANCED # This "visible if" clause make very little sense since this menu is already under "if LED_ADVANCED"

config LED_DEBUG
    bool "Enable LED debugging"
    default n
    help
        "Enable LED debugging"

config LED_CUSTOM_PATTERN
    bool "Custom blink pattern"
    default n
    help
        "Enable custom blink pattern"

endmenu

endif # LED_ADVANCED

endif # LED_SUBSYSTEM

config APP_HEARTBEAT_PERIOD_MS
    int "Heartbeat period in ms"
    default 500
    range 100 2000
    help
        "App heartbeat period in ms"

source "Kconfig.zephyr"
```

## prj.conf
```kconfig
CONFIG_GPIO=y
CONFIG_LOG=y
CONFIG_APP_HEARTBEAT_PERIOD_MS=500
CONFIG_SHELL=y
```

## app.overlay
```dts
/ {
    aliases {
        app-led = "/leds/led_0";
    };

    our_driver0: our_driver0 {
        compatible = "our,driver";
        callibration = <37>;
        status = "okay";
    };

    our_driver1: our_driver1 {
        compatible = "our,driver";
        callibration = <42>;
        status = "okay";
    };
};
```

## src/main.cpp
```c
#include <zephyr/logging/log.h>
#include <zephyr/drivers/sensor.h>
#include "our_driver.h"

LOG_MODULE_REGISTER(main, LOG_LEVEL_INF);

int main(void)
{
    const struct device* dev = DEVICE_DT_GET(DT_NODELABEL(our_driver0));
    if (!device_is_ready(dev))
    {
        return -ENODEV;
    }

    enum sensor_channel dummy_sensor_channel = SENSOR_CHAN_ACCEL_X;
    struct sensor_value dummy_sensor_value = {};
    while (1) {
        sensor_sample_fetch(dev);
        k_msleep(CONFIG_APP_HEARTBEAT_PERIOD_MS);
        sensor_channel_get(dev,
                           dummy_sensor_channel,
                           &dummy_sensor_value);
        our_driver_set(dev, 37);
    }
    return 0;
}
```
